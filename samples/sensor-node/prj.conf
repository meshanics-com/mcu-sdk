## CMakeLists.txt
```
cmake_minimum_required(VERSION 3.20.0)

# This sample lives inside the SDK repo, so register the repo root as a Zephyr
# module (its zephyr/module.yml wires in the agent's Kconfig + CMakeLists). A
# customer who pulls the SDK in via their west manifest does not need this line.
list(APPEND EXTRA_ZEPHYR_MODULES ${CMAKE_CURRENT_SOURCE_DIR}/../..)

find_package(Zephyr REQUIRED HINTS $ENV{ZEPHYR_BASE})
project(meshanics_sensor_node)

target_sources(app PRIVATE src/main.c)
```

## sysbuild.conf
```
# Build + flash MCUboot alongside the app, so the agent runs as a swappable A/B
# image and can confirm/revert OTA updates.
SB_CONFIG_BOOTLOADER_MCUBOOT=y
# Revertable A/B swap (NOT overwrite-only). The Espressif port defaults this
# choice to overwrite-only, which makes the agent's "test" swap permanent - a
# non-confirming image then boot-loops instead of rolling back. Swap-using-move
# needs no scratch partition and restores true auto-rollback.
SB_CONFIG_MCUBOOT_MODE_SWAP_USING_MOVE=y
```

## prj.conf
```kconfig
# Reference sensor-node app. Enables the Meshanics agent and supplies the proven
# mbedTLS profile + device memory sizing the agent needs (the SDK Kconfig selects
# the subsystems; this file sizes them and pins the cipher/curve profile).

CONFIG_MESHANICS_AGENT=y
CONFIG_MESHANICS_FW_VERSION="1.0.0"

CONFIG_LOG=y
CONFIG_MAIN_STACK_SIZE=4096

# --- ESP32-S3 WiFi driver + network buffers --------------------------------
CONFIG_WIFI_ESP32=y
CONFIG_NET_IPV6=n
CONFIG_HEAP_MEM_POOL_SIZE=131072
CONFIG_NET_PKT_RX_COUNT=16
CONFIG_NET_PKT_TX_COUNT=16
CONFIG_NET_BUF_RX_COUNT=32
CONFIG_NET_BUF_TX_COUNT=32
# Leave CONFIG_ESP32_WIFI_STATIC_RX_BUFFER_NUM at its default (10): cutting it to
# 4 starves the DHCP DISCOVER/OFFER burst right after association, so no default
# route is installed and the first connect to the claim edge fails EHOSTUNREACH.

# --- MCUboot A/B install ----------------------------------------------------
CONFIG_MCUBOOT_IMG_MANAGER=y
CONFIG_IMG_ERASE_PROGRESSIVELY=y

# --- mbedTLS: the proven Meshanics TLS profile (REQUIRED) -------------------
# A single TLS 1.3 ECDHE session peaks ~45-55 KB (incl. the 16 KB input record,
# drawn from this heap), so 56 KB carries it; the input buffer must hold a full
# 16 KB record because a sustained download from the Go TLS server ramps to the
# record max.
# The enroll boot briefly needs more than the default 4 credential slots (claim
# anchor + the device cert/key for the manifest-key hop, alongside the
# operational set). enroll frees its provisioning creds when done, but keep
# headroom.
CONFIG_TLS_MAX_CREDENTIALS_NUMBER=8

CONFIG_MBEDTLS_HEAP_SIZE=56000
CONFIG_MBEDTLS_AES_ROM_TABLES=y
CONFIG_MBEDTLS_SSL_IN_CONTENT_LEN=16384
CONFIG_MBEDTLS_SSL_OUT_CONTENT_LEN=4096

# TLS 1.3 (the public claim edge is 1.3-only; the device negotiates 1.3 on every
# hop). The 1.3 ciphersuites are distinct Kconfig symbols from the 1.2 ones.
CONFIG_MBEDTLS_SSL_PROTO_TLS1_3=y
CONFIG_MBEDTLS_SSL_TLS1_3_KEY_EXCHANGE_MODE_EPHEMERAL_ENABLED=y
CONFIG_PSA_WANT_ALG_HKDF=y
CONFIG_PSA_WANT_ALG_HKDF_EXTRACT=y
CONFIG_PSA_WANT_ALG_HKDF_EXPAND=y
CONFIG_MBEDTLS_CIPHERSUITE_TLS1_3_AES_128_GCM_SHA256=y
CONFIG_MBEDTLS_CIPHERSUITE_TLS1_3_AES_256_GCM_SHA384=y

# TLS 1.2 ECDHE suites for the device-mTLS endpoints.
CONFIG_MBEDTLS_CIPHERSUITE_TLS_ECDHE_ECDSA_WITH_AES_128_GCM_SHA256=y
CONFIG_MBEDTLS_CIPHERSUITE_TLS_ECDHE_ECDSA_WITH_AES_256_GCM_SHA384=y
CONFIG_MBEDTLS_CIPHERSUITE_TLS_ECDHE_RSA_WITH_AES_128_GCM_SHA256=y
CONFIG_MBEDTLS_CIPHERSUITE_TLS_ECDHE_RSA_WITH_AES_256_GCM_SHA384=y

# Send the SNI extension: the multi-site claim edge aborts a no-SNI ClientHello
# with a fatal internal_error alert.
CONFIG_MBEDTLS_SSL_SERVER_NAME_INDICATION=y

# Curves/algos. P-256 = our device identity + the device-mTLS endpoints. P-384 is
# REQUIRED to even parse the public claim edge's certificate chain (Let's Encrypt
# / ISRG Root X2 is secp384r1 / ECDSA-SHA384); without it the anchor fails to
# parse and the handshake aborts.
CONFIG_PSA_WANT_KEY_TYPE_ECC_KEY_PAIR_IMPORT=y
CONFIG_PSA_WANT_KEY_TYPE_ECC_KEY_PAIR_GENERATE=y
CONFIG_PSA_WANT_KEY_TYPE_ECC_PUBLIC_KEY=y
CONFIG_PSA_WANT_ALG_ECDSA=y
CONFIG_PSA_WANT_ALG_ECDH=y
CONFIG_PSA_WANT_ECC_SECP_R1_256=y
CONFIG_PSA_WANT_ECC_SECP_R1_384=y
CONFIG_PSA_WANT_ALG_SHA_256=y
CONFIG_PSA_WANT_ALG_SHA_384=y
CONFIG_PSA_WANT_ALG_GCM=y
# RSA verification for the public-edge (Let's Encrypt) chain.
CONFIG_PSA_WANT_ALG_RSA_PKCS1V15_SIGN=y
CONFIG_PSA_WANT_KEY_TYPE_RSA_PUBLIC_KEY=y
CONFIG_PSA_WANT_ALG_RSA_PSS=y

# Your application's own drivers/subsystems go here (I2C, sensors, GPIO, ...).
```

## src/main.c
```c
/*
 * sensor-node - a complete reference app showing the Meshanics MCU SDK DX.
 *
 * Your business logic is the star; the agent runs OTA + identity + rollback in
 * the background. You build and sign THIS firmware; Meshanics rolls out updates.
 */
#include <meshanics/agent.h>

#include <zephyr/kernel.h>
#include <zephyr/logging/log.h>

LOG_MODULE_REGISTER(sensor_node, LOG_LEVEL_INF);

/* Replace these with your real drivers. */
static double read_temperature(void) { return 24.5; }
static void   fan_set(bool on)        { ARG_UNUSED(on); }

static void on_state(meshanics_state st, void *user)
{
	ARG_UNUSED(user);
	LOG_INF("meshanics: state -> %d", (int)st);
}

int main(void)
{
	const meshanics_config cfg = {
		.on_state = on_state,
		/* .firmware_version defaults to CONFIG_MESHANICS_FW_VERSION */
	};

	if (meshanics_agent_start(&cfg) != MESHANICS_OK) {
		LOG_ERR("meshanics agent failed to start");
	}

	/* Your control loop. The agent thread handles connectivity + updates. */
	while (1) {
		double t = read_temperature();
		fan_set(t > 30.0);
		meshanics_report_metric("temp_c", t);
		k_sleep(K_SECONDS(5));
	}
	return 0;
}
```
